## config/boards/arm/egoc/Kconfig.board
```kconfig
# nice!nano board configuration

# Copyright (c) 2020 Pete Johanson
# SPDX-License-Identifier: MIT

config BOARD_EGOC
    bool "egoc"
    depends on SOC_NRF52840_QIAA
```

## config/boards/arm/egoc/Kconfig.defconfig
```kconfig
# Copyright (c) 2021 The ZMK Contributors
# SPDX-License-Identifier: MIT

if BOARD_EGOC

config BOARD
    default "egoc"

if USB_DEVICE_STACK

config USB_NRFX
    default y

endif # USB_DEVICE_STACK

config BT_CTLR
    default BT

endif # BOARD_EGOC
```

## config/boards/arm/egoc_dongle/Kconfig.board
```kconfig
# nice!nano board configuration

# Copyright (c) 2020 Pete Johanson
# SPDX-License-Identifier: MIT

config BOARD_EGOC_DONGLE
    bool "egoc_dongle"
    depends on SOC_NRF52840_QIAA
```

## config/boards/arm/egoc_dongle/Kconfig.defconfig
```kconfig
if BOARD_EGOC_DONGLE

config BOARD
	default "egoc_dongle"

if USB

config USB_NRFX
	default y

config USB_DEVICE_STACK
	default y

endif # USB

config BT_CTLR
	default BT

endif # BOARD_EGOC_DONGLE
```

## config/boards/shields/cygnus/Kconfig.defconfig
```kconfig
if SHIELD_CYGNUS_DONGLE || SHIELD_CYGNUS_LEFT || SHIELD_CYGNUS_RIGHT

	config ZMK_BLE
		default y

	config ZMK_KEYBOARD_NAME
		default "cygnus"

	config ZMK_SPLIT
		default y

endif

if SHIELD_CYGNUS_DONGLE

	config ZMK_USB
		default y

	config ZMK_SPLIT_ROLE_CENTRAL
		default y

	config ZMK_SPLIT_BLE_CENTRAL_PERIPHERALS
		default 2
endif
```

## config/west.yml
```yaml
manifest:
  remotes:
    - name: zmkfirmware
      url-base: https://github.com/zmkfirmware
    - name: fujisheng
      url-base: https://github.com/fujisheng
  projects:
    - name: zmk
      remote: fujisheng
      revision: adv360-z3.2-2
    # - name: zmk
    #   remote: zmkfirmware
    #   revision: main
      import: app/west.yml
  self:
    path: config
```
